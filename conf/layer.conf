## conf/layer.conf
```bitbake
# layer.conf:meta-bcdevices
BBPATH .= ":${LAYERDIR}"

BBFILES += "${LAYERDIR}/recipes-*/*/*.bb \
            ${LAYERDIR}/recipes-*/*/*.bbappend \
            ${LAYERDIR}/images/*.bb"

BBFILE_COLLECTIONS += "bcdevices"

BBFILE_PATTERN_bcdevices = "^${LAYERDIR}/"
BBFILE_PRIORITY_bcdevices = "5"

LAYERVERSION_bcdevices = "1"
LAYERSERIES_COMPAT_bcdevices = "scarthgap styhead walnascar whinlatter"

LAYERDEPENDS_bcdevices = "core"

#PREFERRED_VERSION_python3-spsdk = "2.0.0"

INHERIT += "image-buildinfo"
```
